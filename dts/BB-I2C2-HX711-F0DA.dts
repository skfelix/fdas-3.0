/*
 * Copyright (C) 2013 CircuitCo
 *
 * Virtual cape for I2C2 on connector pins P9.19 P9.20
 *
 * This program is free software; you can redistribute it and/or modify
 * it under the terms of the GNU General Public License version 2 as
 * published by the Free Software Foundation.
 */
/dts-v1/;
/plugin/;

#include <dt-bindings/board/am335x-bbw-bbb-base.h>
#include <dt-bindings/gpio/gpio.h>
#include <dt-bindings/pinctrl/am33xx.h>

/ {
	model = "TI AM335x BeagleBone Green";
	compatible = "ti,beaglebone", "ti,beaglebone-black", "ti,beaglebone-green";

	/* identification */
	part-number = "BB-I2C2-HX711";
	version = "F0DA";

	weight@0 {
		pinctrl-names = "default";
		pinctrl-0 = <&bb_hx711_pins>;

		compatible = "avia,hx711";
		sck-gpios = <&gpio2 3 GPIO_ACTIVE_HIGH>;
		dout-gpios = <&gpio2 2 GPIO_ACTIVE_HIGH>;
		avdd-suppy = <&vmmcsd_fixed>;
	};


	fragment@0 {
		target = <&am33xx_pinmux>;
		__overlay__ {
			bb_hx711_pins: pinmux_bb_hx711_pins {
				pinctrl-single,pins = <
					BONE_P8_08 (PIN_OUTPUT | MUX_MODE7) /* gpio2_3 */
					BONE_P8_07 (PIN_INPUT | MUX_MODE7) /* gpio2_2 */
				>;
			};

		};
	};

};
